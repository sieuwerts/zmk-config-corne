## config/west.yml
```yaml
manifest:
  remotes:
    - name: zmkfirmware
      url-base: https://github.com/zmkfirmware
    # - name: m165437  # gem
    #   url-base: https://github.com/M165437  # gem
    # Additional modules containing boards/shields/custom code can be listed here as well
    # See https://docs.zephyrproject.org/3.2.0/develop/west/manifest.html#projects
  projects:
    - name: zmk
      remote: zmkfirmware
      # PIN: last release before Zephyr 4.1 (nice!view display works here).
      # To resume the 4.1 upgrade, set revision back to `main` and revert the
      # pins in build.yaml + .github/workflows/build.yml.
      revision: v0.3.0
      import: app/west.yml
    # - name: nice-view-gem  # gem
    #   remote: m165437  # gem
    #   revision: main  # gem
  self:
    path: config
```
